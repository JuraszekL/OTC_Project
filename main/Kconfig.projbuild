## main/Kconfig.projbuild
```kconfig
# put here your custom config value
menu "Example Configuration"
config ESP_WIFI_SSID
    string "WiFi SSID"
    default "myssid"
    help
	SSID (network name) for the example to connect to.

config ESP_WIFI_PASSWORD
    string "WiFi Password"
    default "mypassword"
    help
	WiFi password (WPA or WPA2) for the example to use.
	
config ESP_WEATHER_API_KEY
	string "API Key"
	default ""
	help
	API Key to obtain weather data from http dervice
endmenu
```
